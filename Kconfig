## Kconfig
```kconfig
config USR_LIB_AES
  bool  "userspace libaes with HW Cryp support"
  default y
  select EXT_SECAES
  ---help---
  Support for AES implementation in both software and
  hardware mode, depending on the SoC.

menu "libaes features"
  depends on USR_LIB_AES

config USR_LIB_AES_SELFTESTS
  default n
  bool "Embed AES selftest vectors"

config USR_LIB_AES_DIFFERENCIATE_DFU_FW_BUILD
   default y
   bool "Differenciate DFU and FW featureset"


if USR_LIB_AES_DIFFERENCIATE_DFU_FW_BUILD

###### FW mode specific content
menu "Firwmare-mode libAES features"

config USR_LIB_AES_FW_PERF
  default y
  bool "Embed AES performance test benchmarks"

config USR_LIB_AES_FW_ALGO_UNMASKED
  default y
  bool "Embed AES unmasked (unprotected) support"

choice
  prompt "Unmasked AES type"
  default USR_LIB_AES_FW_ALGO_UNMASKED_TABLE
config USR_LIB_AES_FW_ALGO_UNMASKED_TABLE
  depends on USR_LIB_AES_FW_ALGO_UNMASKED
  bool "Embed AES ANSSI unmasked with tables (high speed)"
  ---help---
  Support for table based AES implementation with high
  flash and SRAM usage but high performance.
config USR_LIB_AES_FW_ALGO_UNMASKED_SIMPLE
  depends on USR_LIB_AES_FW_ALGO_UNMASKED
  bool "Embed AES ANSSI unmasked with compact implementation"
  ---help---
  Support for simple AES implementation with minimal
  flash and SRAM usage but slow performance.
endchoice

config USR_LIB_AES_FW_ALGO_ANSSI_MASKED
  default y
  select USR_LIB_RNG
  bool "Embed AES ANSSI masked"

config USR_LIB_AES_FW_ALGO_CRYP_SUPPORT
  default y
  bool "Embed AES HW CRYP Support"

choice
  prompt "CRYP support type"
  default USR_LIB_AES_FW_ALGO_CRYP_SUPPORT_DMA
config USR_LIB_AES_FW_ALGO_CRYP_SUPPORT_POLL
  depends on USR_LIB_AES_FW_ALGO_CRYP_SUPPORT
  bool "CRYP support in poll mode"
config USR_LIB_AES_FW_ALGO_CRYP_SUPPORT_DMA
  depends on USR_LIB_AES_FW_ALGO_CRYP_SUPPORT
  bool "CRYP support in DMA mode"
endchoice


endmenu

###### DFU mode specific content
menu "DFU-Mode libAES fatures"

config USR_LIB_AES_DFU_PERF
  default n
  bool "Embed AES performance test benchmarks"

config USR_LIB_AES_DFU_ALGO_UNMASKED
  default n
  bool "Embed AES unmasked (unprotected) support"

choice
  prompt "Unmasked AES type"
  default USR_LIB_AES_DFU_ALGO_UNMASKED_TABLE
config USR_LIB_AES_DFU_ALGO_UNMASKED_TABLE
  depends on USR_LIB_AES_DFU_ALGO_UNMASKED
  bool "Embed AES ANSSI unmasked with tables (high speed)"
  ---help---
  Support for table based AES implementation with high
  flash and SRAM usage but high performance.
config USR_LIB_AES_DFU_ALGO_UNMASKED_SIMPLE
  depends on USR_LIB_AES_DFU_ALGO_UNMASKED
  bool "Embed AES ANSSI unmasked with compact implementation"
  ---help---
  Support for simple AES implementation with minimal
  flash and SRAM usage but slow performance.
endchoice

config USR_LIB_AES_DFU_ALGO_ANSSI_MASKED
  default y
  select USR_LIB_RNG
  bool "Embed AES ANSSI masked"

config USR_LIB_AES_DFU_ALGO_CRYP_SUPPORT
  default y
  bool "Embed AES HW CRYP Support"

choice
  prompt "CRYP support type"
  default USR_LIB_AES_DFU_ALGO_CRYP_SUPPORT_DMA
config USR_LIB_AES_DFU_ALGO_CRYP_SUPPORT_POLL
  depends on USR_LIB_AES_DFU_ALGO_CRYP_SUPPORT
  bool "CRYP support in poll mode"
config USR_LIB_AES_DFU_ALGO_CRYP_SUPPORT_DMA
  depends on USR_LIB_AES_DFU_ALGO_CRYP_SUPPORT
  bool "CRYP support in DMA mode"
endchoice

endmenu

endif

###### other case: generic content
if !USR_LIB_AES_DIFFERENCIATE_DFU_FW_BUILD

config USR_LIB_AES_PERF
  default n
  bool "Embed AES performance test benchmarks"

config USR_LIB_AES_ALGO_UNMASKED
  default y
  bool "Embed AES unmasked (unprotected) support"

choice
  prompt "Unmasked AES type"
  default USR_LIB_AES_ALGO_UNMASKED_TABLE
config USR_LIB_AES_ALGO_UNMASKED_TABLE
  depends on USR_LIB_AES_ALGO_UNMASKED
  bool "Embed AES ANSSI unmasked with tables (high speed)"
  ---help---
  Support for table based AES implementation with high
  flash and SRAM usage but high performance.
config USR_LIB_AES_ALGO_UNMASKED_SIMPLE
  depends on USR_LIB_AES_ALGO_UNMASKED
  bool "Embed AES ANSSI unmasked with compact implementation"
  ---help---
  Support for simple AES implementation with minimal
  flash and SRAM usage but slow performance.
endchoice

config USR_LIB_AES_ALGO_ANSSI_MASKED
  default y
  select USR_LIB_RNG
  bool "Embed AES ANSSI masked"

config USR_LIB_AES_ALGO_CRYP_SUPPORT
  default y
  bool "Embed AES HW CRYP Support"

choice
  prompt "CRYP support type"
  default USR_LIB_AES_ALGO_CRYP_SUPPORT_DMA
config USR_LIB_AES_ALGO_CRYP_SUPPORT_POLL
  depends on USR_LIB_AES_ALGO_CRYP_SUPPORT
  bool "CRYP support in poll mode"
config USR_LIB_AES_ALGO_CRYP_SUPPORT_DMA
  depends on USR_LIB_AES_ALGO_CRYP_SUPPORT
  bool "CRYP support in DMA mode"
endchoice

endif

endmenu
```
